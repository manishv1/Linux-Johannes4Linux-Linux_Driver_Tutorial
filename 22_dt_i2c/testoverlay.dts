/dts-v1/;
/plugin/;
/ {
	compatible = "brcm,bcm2835";
	fragment@0 {
		target = <&i2c1>;
		__overlay__ {
			#address-cells = <1>;
			#size-cells = <0>;

			my_adc: my_adc@10 {
				compatible = "brightlight,myadc";
				reg = <0x10>;
				status = "okay";
			};
		};
	};
};
