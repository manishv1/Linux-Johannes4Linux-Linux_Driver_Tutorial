/dts-v1/;
/plugin/;
/ {
	compatible = "brcm,bcm2835";
	fragment@0 {
		target = <&spidev0>;
		__overlay__ {
			status = "disabled";
		};
	};
		
	fragment@1 {
		target = <&spi0>;
		__overlay__ {
			status = "okay";
			#address-cells = <1>;
			#size-cells = <0>;

			my_adc: my_adc@0 {
				compatible = "brightlight,myadc";
				reg = <0x0>;
				spi-max-frequency = <4000>;
				spi-bits-per-word = <8>;
				status = "okay";
			};
		};
	};
};
